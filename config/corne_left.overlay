/*
 * Configuration Devicetree pour la moitié gauche (Central)
 * - Écran OLED SSD1306 sur bus I2C standard (&pro_micro_i2c / 0x3C)
 * - Résistances de tirage I2C internes activées (bias-pull-up)
 */

&i2c0_default {
    group1 {
        bias-pull-up;
    };
};

&i2c0_sleep {
    group1 {
        bias-pull-up;
    };
};
